## main/Kconfig.projbuild
```kconfig
menu "EDLAVP-ESP-FW Configuration"
    menu "FreeRTOS Configuration"
        menu "Stack allocation"
            config NTP_MANAGER_STACK_SIZE
                int "ntp_manager task stack size"
                default 4096
                help
                    The size of the stack allocated to the ntp_manager task
            config SENSOR_MANAGER_DS18B20_STACK_SIZE
                int "sensor_manager_ds18b20 task stack size"
                default 4096
                help
                    The size of the stack allocated to the sensor_manager_ds18b20 task
            config SENSOR_MANAGER_DS18B20_STACK_SIZE
                int "sensor_manager_dht11 task stack size"
                default 4096
                help
                    The size of the stack allocated to the sensor_manager_dht11 task
            config MQTT_MANAGER_STACK_SIZE
                int "mqtt_manager task stack size"
                default 8192
                help
                    The size of the stack allocated to the mqtt_manager task. Note that the mqtt_manager task does a lot of JSON and string stuff, so it should have a lot of space to work with.
        endmenu
        menu "Queues"
            config READOUT_QUEUE_SIZE
                int "Sensor readout queue size"
                default 20
                help
                    The amount of readouts the readout queue can hold (to be published) before overflowing.
        endmenu
    endmenu
    menu "Wi-Fi Configuration"
        config WIFI_SSID
            string "Wi-Fi SSID"
            default "mywifi"
            help
                SSID (network name) for the Wi-Fi network to connect to.

        config WIFI_PASSWORD
            string "Wi-Fi Password"
            default "mypassword"
            help
                Wi-Fi password (WPA or WPA2) for the Wi-Fi network.

        config WIFI_MAXIMUM_RETRY
            int "Maximum retry attempts"
            default 5
            help
                Set the maximum retry to avoid station reconnecting to the AP unlimited when the AP is really inexistent.
    endmenu

    menu "NTP Timesync Configuration"
        config TIMESYNC_INTERVAL
            int "NTP Timesync Interval"
            default 86400
            help
                Interval between NTP syncs, in seconds. Default is 86400 for once a day.
        config TIMESYNC_TIMEOUT
                int "NTP Timesync Timeout"
                default 10
                help
                    The longest that an NTP sync can take before timing out. Default is 10 seconds.
        config TIMESYNC_ERROR_RETRY_COOLDOWN
                int "NTP Timesync Retry Cooldown"
                default 10
                help
                    Interval before retrying to sync with NTP, in seconds, after a failed attempt. Default is 10.
    endmenu

    menu "MQTT Configuration"
        config MQTT_BROKER_URL
            string "MQTT Broker URL"
            default ""
            help
                The full URL for your MQTT broker.
        config MQTT_USERNAME
                string "MQTT username"
                default ""
                help
                    The username to connect to the MQTT broker with.
        config MQTT_PASSWORD
                string "MQTT password"
                default ""
                help
                    The password to connect to the MQTT broker with.
    endmenu

    menu "I/O and Hardware Configuration"
        menu "Sensors"
            menu "DS18B20 Temperature Sensor"
                config SOFTWARE_DS18B20_READOUT_INTERVAL
                        int "Sensor readout interval"
                        default 10
                        help
                            Interval between sensor polls, in seconds. Default is once every 10 seconds.
                config HARDWARE_DS18B20_GPIO_PIN
                    int "Sensor GPIO pin"
                    default 17
                    help
                        The GPIO pin that the DS18B20 sensor is connected to.
            endmenu
            menu "DHT11 Humidity Sensor"
                    comment "For temperature readouts, the DS18B20 is used instead as it is more accurate. EDLAVP only supports DHT11 for humidity."
                    config SOFTWARE_DHT11_READOUT_INTERVAL
                            int "Sensor readout interval"
                            default 20
                            help
                                Interval between sensor polls, in seconds. Default is once every 10 seconds.
                    config HARDWARE_DHT11_GPIO_PIN
                        int "Sensor GPIO pin"
                        default 18
                        help
                            The GPIO pin that the DHT11 sensor is connected to.
                    config HARDWARE_DHT11_INTERNAL_PULLUP
                        bool "DHT11 internal pullup"
                        default y
                        help
                            Enable or disable the internal DHT11 pullup resistor.
                endmenu
        endmenu
    endmenu
endmenu
```
